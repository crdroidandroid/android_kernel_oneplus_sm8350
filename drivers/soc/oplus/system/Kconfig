## drivers/soc/oplus/system/Kconfig
```kconfig
# SPDX-License-Identifier: GPL-2.0-only
# Copyright (C) 2018-2020 Oplus. All rights reserved.

config OPLUS_SYSTEM_KERNEL
  bool "Config oplus system feature "
  default y
  help
	Define this config to add OPLUS sytstem kernel feature.

config OPLUS_SYSTEM_CHANGE
  tristate "Config "
  help
        Define this config to include OPLUS changes.

source "drivers/soc/oplus/system/feedback/Kconfig"
source "drivers/soc/oplus/system/oplus_project/Kconfig"
source "drivers/soc/oplus/system/project_info/Kconfig"
source "drivers/soc/oplus/system/cmdline_parser/Kconfig"
source "drivers/soc/oplus/system/oplus_mm_fb/Kconfig"
```
